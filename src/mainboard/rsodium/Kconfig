## src/mainboard/rsodium/Kconfig
```kconfig
## SPDX-License-Identifier: GPL-2.0-only

if VENDOR_RSODIUM

choice
	prompt "Mainboard model"

source "src/mainboard/rsodium/*/Kconfig.name"

endchoice

source "src/mainboard/rsodium/*/Kconfig"

config MAINBOARD_VENDOR
	default "R-SODIUN Technology"

endif # VENDOR_RSODIUM
```

## src/mainboard/rsodium/k9eth/Kconfig
```kconfig
## SPDX-License-Identifier: GPL-2.0-only

if BOARD_RSODIUM_K9ETH

config BOARD_SPECIFIC_OPTIONS
	def_bool y
	select BOARD_ROMSIZE_KB_16384
	select HAVE_ACPI_RESUME
	select HAVE_ACPI_TABLES
	select HAVE_CMOS_DEFAULT
	select HAVE_OPTION_TABLE
	select INTEL_GMA_HAVE_VBT
	select INTEL_INT15
	select MAINBOARD_HAS_LIBGFXINIT
	select NORTHBRIDGE_INTEL_SANDYBRIDGE
	select SERIRQ_CONTINUOUS_MODE
	select SOUTHBRIDGE_INTEL_C216
	select SUPERIO_NUVOTON_NCT6776
	select USE_NATIVE_RAMINIT

config MAINBOARD_DIR
	default "rsodium/k9eth"

config MAINBOARD_PART_NUMBER
	default "K9-ETH"

endif
```

## src/mainboard/rsodium/k9eth/Kconfig.name
```kconfig
## SPDX-License-Identifier: GPL-2.0-only

config BOARD_RSODIUM_K9ETH
	bool "K9-ETH"
```
